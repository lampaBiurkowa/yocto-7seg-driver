## meta-custom-7seg/conf/layer.conf
```bitbake
# We have a conf and classes directory, add to BBPATH
BBPATH .= ":${LAYERDIR}"

# We have recipes-* directories, add to BBFILES
BBFILES += "${LAYERDIR}/recipes-*/*/*.bb \
            ${LAYERDIR}/recipes-*/*/*.bbappend"

BBFILE_COLLECTIONS += "meta-custom-7seg"
BBFILE_PATTERN_meta-custom-7seg = "^${LAYERDIR}/"
BBFILE_PRIORITY_meta-custom-7seg = "6"

LAYERDEPENDS_meta-custom-7seg = "core"
LAYERSERIES_COMPAT_meta-custom-7seg = "mickledore scarthgap"
```

## meta-custom-rust-7seg/conf/layer.conf
```bitbake
# We have a conf and classes directory, add to BBPATH
BBPATH .= ":${LAYERDIR}"

# We have recipes-* directories, add to BBFILES
BBFILES += "${LAYERDIR}/recipes-*/*/*.bb \
            ${LAYERDIR}/recipes-*/*/*.bbappend"

BBFILE_COLLECTIONS += "meta-custom-rust-7seg"
BBFILE_PATTERN_meta-custom-rust-7seg = "^${LAYERDIR}/"
BBFILE_PRIORITY_meta-custom-rust-7seg = "6"

LAYERDEPENDS_meta-custom-rust-7seg = "core"
LAYERSERIES_COMPAT_meta-custom-rust-7seg = "scarthgap mickledore"
```
